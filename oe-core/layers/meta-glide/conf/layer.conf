## oe-core/layers/meta-glide/conf/layer.conf
```bitbake
# We have a conf and classes directory, add to BBPATH
BBPATH .= ":${LAYERDIR}"

# We have recipes-* directories, add to BBFILES
BBFILES += "${LAYERDIR}/recipes-*/*/*.bb \
            ${LAYERDIR}/recipes-*/*/*.bbappend"

BBFILE_COLLECTIONS += "meta-glide"
BBFILE_PATTERN_meta-glide = "^${LAYERDIR}/"
BBFILE_PRIORITY_meta-glide = "95"
LAYERVERSION_meta-glide = "4"
LAYERSERIES_COMPAT_meta-glide = "rocko"
KERNEL_MODULE_AUTOLOAD = "arrowkey"
```

## oe-core/layers/meta-luajit/conf/layer.conf
```bitbake
# We have a conf and classes directory, add to BBPATH
BBPATH .= ":${LAYERDIR}"

# We have recipes-* directories, add to BBFILES
BBFILES += "${LAYERDIR}/recipes-*/*/*.bb \
            ${LAYERDIR}/recipes-*/*/*.bbappend"

BBFILE_COLLECTIONS += "luajit"
BBFILE_PATTERN_luajit = "^${LAYERDIR}/"
BBFILE_PRIORITY_luajit = "10"

# This should only be incremented on significant changes that will
# cause compatibility issues with other layers
LAYERVERSION_luajit = "1"
LAYERSERIES_COMPAT_luajit = "rocko"
```

## oe-core/layers/meta-rtlwifi/conf/layer.conf
```bitbake
# Append conf dir to BBPATH
BBPATH .= ":${LAYERDIR}"

# Append recipe dir to BBFILES
BBFILES += "${LAYERDIR}/recipes*/*/*.bb ${LAYERDIR}/recipes*/*/*.bbappend"

BBFILE_COLLECTIONS += "meta-rtlwifi"
BBFILE_PATTERN_meta-rtlwifi = "${LAYERDIR}/"
BBFILE_PRIORITY_rtlwifi = "1"
```

## oe-core/layers/meta-tc-gcc11/conf/layer.conf
```bitbake
# We have a conf and classes directory, append to BBPATH
BBPATH .= ":${LAYERDIR}"

# If we have a recipes directory, add to BBFILES
BBFILES += "${LAYERDIR}/recipes-*/*/*.bb \
            ${LAYERDIR}/recipes-*/*/*.bbappend"

BBFILE_COLLECTIONS += "meta-tc-gcc11"
BBFILE_PATTERN_meta-tc-gcc11 := "^${LAYERDIR}/"
BBFILE_PRIORITY_meta-tc-gcc11 = "90"
BBFILE_PRIORITY_core = "10"

LAYERVERSION_meta-tc-gcc11 = "10"

LAYERDEPENDS_meta-tc-gcc11 = "core"
LAYERSERIES_COMPAT_meta-tc-gcc11 = "rocko"

PATH := "${PATH}:${LAYERDIR}/bin"

# Define the alternative toolchain
SECONDARYTC = 'gcc11'

# Enable the secondary toolchain
INHERIT += 'tc-secondary tc-blacklist'
```
